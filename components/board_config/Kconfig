## components/board_config/Kconfig
```kconfig
menu "BluButton"

choice BB_BOARD_PROFILE
    prompt "Board profile"
    default BB_BOARD_ESP32_DEVKIT_V1 if IDF_TARGET_ESP32
    default BB_BOARD_ESP32C3_SUPERMINI if IDF_TARGET_ESP32C3
    help
        Select the concrete board profile so board-specific GPIO mappings stay
        outside the shared firmware modules.

    config BB_BOARD_ESP32_DEVKIT_V1
        bool "ESP32 DevKit V1"
        depends on IDF_TARGET_ESP32

    config BB_BOARD_ESP32C3_SUPERMINI
        bool "ESP32-C3 SuperMini (common pinout)"
        depends on IDF_TARGET_ESP32C3

    config BB_BOARD_XIAO_ESP32_C3
        bool "Seeed XIAO ESP32-C3"
        depends on IDF_TARGET_ESP32C3
endchoice

config BB_XIAO_ESP32_C3_A0_BATTERY
    bool "Enable XIAO ESP32-C3 A0/GPIO2 battery telemetry"
    depends on BB_BOARD_XIAO_ESP32_C3
    default n
    help
        Enable this only for a XIAO ESP32-C3 modified with an external 2:1
        divider from battery voltage to A0/GPIO2.

        GPIO2 is also D0 on this board profile, so enabling this option removes
        D0 from the active button map and exposes three logical buttons.

endmenu
```
